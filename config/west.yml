## config/west.yml
```yaml
manifest:
  remotes:
    - name: zmkfirmware
      url-base: https://github.com/zmkfirmware
    # nice_oled
    - name: mctechnology17
      url-base: https://github.com/mctechnology17
    # urob's zmk modules
    - name: urob
      url-base: https://github.com/urob
  projects:
    - name: zmk
      remote: urob
      revision: main
      import: app/west.yml
    # nice_oled
    - name: zmk-nice-oled
      remote: mctechnology17
      revision: main
    # urob's helpers (key-labels, behavior macros)
    - name: zmk-helpers
      remote: urob
      revision: v0.3
    # auto-layer (num-word)
    - name: zmk-auto-layer
      remote: urob
      revision: v0.3
  self:
    path: config
```
